## Kconfig
```
# This stems from Nordic Semiconductor's asset tracker sample

#
# Copyright (c) 2019 Nordic Semiconductor ASA
#
# SPDX-License-Identifier: LicenseRef-Nordic-5-Clause
#

menu "nRF91 Simple Tracker"

config TRACKER_VERSION_MAJOR
	int "Major verison number"
	default 0

config TRACKER_VERSION_MINOR
	int "Minor verison number"
	default 2

config TRACKER_VERSION_PATCH
	int "Patch verison number"
	default 1

config COAP_DEVICE_NAME
	string "Device resource name - this will be the device name on the CoAP server"
	default "cali.Lars"

config COAP_POST_RESOURCE
	string "Parent CoAP resource - this is the parent resource of your device resource name"
	default "echo"

config COAP_SERVER_HOSTNAME
	string "CoAP server hostname"
	default "californium.eclipseprojects.io"

config COAP_SERVER_PORT
	int "CoAP server port"
	default 5684
	
config COAP_SERVER_PSK
	string "Server PSK"
	default "2e666f726e69756d"

config TRACKER_PERIODIC_INTERVAL
	int "Fix interval for periodic GPS fixes. This determines your tracking frequency"
	range 10 65535
	default 120
	help
	  Fix interval (in seconds) for periodic fixes.

config TRACKER_PERIODIC_TIMEOUT
	int "Fix timeout for periodic GPS fixes"
	range 0 65535
	default 600
	help
	  Fix timeout (in seconds) for periodic fixes.
	  If set to zero, GNSS is allowed to run indefinitely until a valid PVT estimate is produced.

config GNSS_LOW_ACCURACY
	bool "Allow low accuracy fixes."
	help
	  Helps with faster fixes.GNSS demonstrates a looser acceptance criterion for a fix.

config GNSS_HIGH_ACCURACY_TIMING_SOURCE
	bool "Use Crystal oscillator"
	help
	  Use crystal oscillator (TCXO) timing source for the GNSS interface 
	  instead of the default Real time clock (RTC).TCXO has higher power consumption than RTC

endmenu

menu "Zephyr Kernel"
source "Kconfig.zephyr"
endmenu
```

## prj.conf
```kconfig
# This stems from Nordic Semiconductor's asset tracker sample

#
# Copyright (c) 2019 Nordic Semiconductor ASA
#
# SPDX-License-Identifier: LicenseRef-Nordic-5-Clause
#

# Logging
CONFIG_LOG=y
CONFIG_LOG_PRINTK=y

# Button and LED support
CONFIG_DK_LIBRARY=y

# Newlib
CONFIG_NEWLIB_LIBC=y
CONFIG_FPU=y
CONFIG_NEWLIB_LIBC_FLOAT_PRINTF=y

# Networking
CONFIG_NETWORKING=y
CONFIG_NET_NATIVE=n
CONFIG_NET_SOCKETS_OFFLOAD=y
CONFIG_NET_SOCKETS=y
CONFIG_NET_SOCKETS_POSIX_NAMES=y

# Memory
CONFIG_MAIN_STACK_SIZE=8192
CONFIG_HEAP_MEM_POOL_SIZE=8192

# Modem library
CONFIG_NRF_MODEM_LIB=y
CONFIG_MODEM_KEY_MGMT=y

# LTE link control
CONFIG_LTE_LINK_CONTROL=y
CONFIG_LTE_AUTO_INIT_AND_CONNECT=n
CONFIG_LTE_NETWORK_MODE_LTE_M_GPS=y

# AT commands interface
CONFIG_AT_HOST_LIBRARY=n
CONFIG_UART_INTERRUPT_DRIVEN=y

# CoAP
CONFIG_COAP=y

CONFIG_TRACKER_PERIODIC_INTERVAL=30
```

## src/main.c
```c
#include <zephyr/kernel.h>
#include <modem/modem_key_mgmt.h>
#include <zephyr/logging/log.h>
#include <dk_buttons_and_leds.h>

#include "gnss.h"
#include "lte.h"
#include "coap.h"
LOG_MODULE_REGISTER(main_c, LOG_LEVEL_INF);

#define APP_COAP_MAX_MSG_LEN 1280
#define APP_COAP_SEND_MAX_MSG_LEN 64

enum tracker_status device_status;
static uint8_t coap_buf[APP_COAP_MAX_MSG_LEN];
static uint8_t coap_sendbuf[APP_COAP_SEND_MAX_MSG_LEN];
struct nrf_modem_gnss_pvt_data_frame current_pvt;
struct nrf_modem_gnss_pvt_data_frame last_pvt;
static int resolve_address_lock = 0;
static int sock;
bool faux_gnss_fix_requested = false; // Generate fake GPS data for testing purposes


static void button_handler(uint32_t button_state, uint32_t has_changed)
{
	static bool toogle = 1;
	if (has_changed & DK_BTN1_MSK && button_state & DK_BTN1_MSK)
	{
		if (toogle == 1)
		{
			dk_set_led_on(device_status);
		}
		else
		{
			dk_set_led_off(DK_LED1);
			dk_set_led_off(DK_LED2);
			dk_set_led_off(DK_LED3);
		}
		toogle = !toogle;
	}
	if (has_changed & DK_BTN2_MSK && button_state & DK_BTN2_MSK)
	{
		faux_gnss_fix_requested = true;
		k_sem_give(&gnss_fix_sem);
	}
}

void main(void)
{
	int err, received;
	LOG_INF("Main Unit Version %d.%d.%d started\n", CONFIG_TRACKER_VERSION_MAJOR, CONFIG_TRACKER_VERSION_MINOR, CONFIG_TRACKER_VERSION_PATCH);

	err = modem_key_mgmt_write(SEC_TAG, MODEM_KEY_MGMT_CRED_TYPE_IDENTITY, CONFIG_COAP_DEVICE_NAME, strlen(CONFIG_COAP_DEVICE_NAME));
	if (err)
	{
		LOG_ERR("Failed to write identity: %d\n", err);
		return;
	}

	err = modem_key_mgmt_write(SEC_TAG, MODEM_KEY_MGMT_CRED_TYPE_PSK, CONFIG_COAP_SERVER_PSK, strlen(CONFIG_COAP_SERVER_PSK));
	if (err)
	{
		LOG_ERR("Failed to write identity: %d\n", err);
		return;
	}

	err = dk_leds_init();
	if (err)
	{
		LOG_ERR("Failed to initlize the LEDs Library");
	}
	device_status = status_nolte;

	modem_configure();

	err = dk_buttons_init(button_handler);
	if (err)
	{
		LOG_ERR("Failed to initlize button handler: %d\n", err);
		return;
	}

	LOG_INF("Starting GNSS....");
	gnss_init_and_start();

	while (1)
	{
		k_sem_take(&gnss_fix_sem, K_FOREVER);
		if (faux_gnss_fix_requested)
		{
			LOG_INF("Faux GNSS fix requested");
			faux_gnss_fix_requested = false;
			current_pvt = last_pvt;
			current_pvt.latitude = 59.3294;
			current_pvt.longitude = 18.0686;
			current_pvt.altitude = 0;
			current_pvt.datetime.day = 15;
			current_pvt.datetime.month = 5;
			current_pvt.datetime.year = 2023;
			current_pvt.datetime.hour = 02;
			current_pvt.datetime.minute = 47;
			current_pvt.datetime.seconds = 06;
			current_pvt.datetime.ms = 365;
			current_pvt.accuracy = 5;
			print_fix_data(&current_pvt);
		}
		err = lte_lc_func_mode_set(LTE_LC_FUNC_MODE_NORMAL);
		if (err != 0)
		{
			LOG_ERR("Failed to activate LTE");
			break;
		}
		k_sem_take(&lte_connected, K_FOREVER);
		if (resolve_address_lock == 0)
		{
			LOG_INF("Resolving the server address\n\r");
			if (server_resolve() != 0)
			{
				LOG_ERR("Failed to resolve server name\n");
				return;
			}
			resolve_address_lock = 1;
		}
		LOG_INF("Sending Data over LTE\r\n");
		if (server_connect(sock) != 0)
		{
			LOG_ERR("Failed to initialize CoAP client\n");
			return;
		}

		if (client_post_send(sock, coap_buf, sizeof(coap_buf), coap_sendbuf, sizeof(coap_sendbuf),
							 current_pvt, last_pvt) != 0)
		{
			LOG_ERR("Failed to send GET request, exit...\n");
			break;
		}
		received = recv(sock, coap_buf, sizeof(coap_buf), 0);

		if (received < 0)
		{
			LOG_ERR("Error reading response\n");
			break;
		}

		if (received == 0)
		{
			LOG_ERR("Disconnected\n");
			break;
		}
		err = client_handle_get_response(coap_buf, received);
		if (err < 0)
		{
			LOG_ERR("Invalid response, exit...\n");
			break;
		}

		(void)close(sock);
		err = lte_lc_func_mode_set(LTE_LC_FUNC_MODE_DEACTIVATE_LTE);
		if (err != 0)
		{
			LOG_ERR("Failed to decativate LTE and enable GNSS functional mode");
			break;
		}
	}
	device_status = status_nolte;
	lte_lc_power_off();
	LOG_ERR("Error occoured. Shutting down modem");
}
```

## src/coap.h
```c
#ifndef COAP_H
#define COAP_H

/* INCLUDES */
#include <stdint.h>
#include <zephyr/net/socket.h>
#include <nrf_modem_gnss.h>

/* DEFINES */
#define APP_COAP_SEND_INTERVAL_MS 60000
#define APP_COAP_VERSION 1

/* VARIABLES */

/* FUNCTION PROTOTYPES */
int server_resolve(void);
int server_connect(int sock);
int client_handle_get_response(uint8_t *buf, int received);
int client_post_send(int sock, uint8_t *buf, size_t, uint8_t *sendbuf, size_t sendbuf_size,
							struct nrf_modem_gnss_pvt_data_frame current_pvt,
							struct nrf_modem_gnss_pvt_data_frame last_pvt);

#endif// COAP_H
```

## src/gnss.c
```c
#include "gnss.h"
#include <stdio.h>
#include <nrf_modem_gnss.h>
#include <zephyr/logging/log.h>

LOG_MODULE_REGISTER(GNSS, LOG_LEVEL_INF);

/* SEMAPHORES */
K_SEM_DEFINE(gnss_fix_sem, 0, 1);

/* VARIABLES */
extern enum tracker_status device_status;

/* FUNCTION DEFINITIONS */
void print_fix_data(struct nrf_modem_gnss_pvt_data_frame *pvt_data)
{
	printk("Latitude:       %.06f\n", pvt_data->latitude);
	printk("Longitude:      %.06f\n", pvt_data->longitude);
	printk("Altitude:       %.01f m\n", pvt_data->altitude);
	printk("Time (UTC):     %02u:%02u:%02u.%03u\n",
		   pvt_data->datetime.hour,
		   pvt_data->datetime.minute,
		   pvt_data->datetime.seconds,
		   pvt_data->datetime.ms);
}

static void gnss_event_handler(int event)
{
	int retval;
	switch (event)
	{
	case NRF_MODEM_GNSS_EVT_PVT:
		LOG_INF("Searching for GNSS Satellites....\n\r");
		device_status = status_searching;
		break;
	case NRF_MODEM_GNSS_EVT_FIX:
		LOG_INF("GNSS fix event\n\r");
		break;
	case NRF_MODEM_GNSS_EVT_PERIODIC_WAKEUP:
		LOG_INF("GNSS woke up in periodic mode\n\r");
		break;
	case NRF_MODEM_GNSS_EVT_BLOCKED:
		LOG_INF("GNSS is blocked by LTE event\n\r");
		break;
	case NRF_MODEM_GNSS_EVT_SLEEP_AFTER_FIX:
		LOG_INF("GNSS enters sleep because fix was achieved in periodic mode\n\r");
		device_status = status_fixed;
		retval = nrf_modem_gnss_read(&last_pvt, sizeof(last_pvt), NRF_MODEM_GNSS_DATA_PVT);
		if (retval == 0)
		{
			current_pvt = last_pvt;
			print_fix_data(&current_pvt);
			k_sem_give(&gnss_fix_sem);
		}
		break;
	case NRF_MODEM_GNSS_EVT_SLEEP_AFTER_TIMEOUT:
		LOG_INF("GNSS enters sleep because fix retry timeout was reached\n\r");
		break;

	default:

		break;
	}
}

int gnss_init_and_start(void)
{
#if defined(CONFIG_GNSS_HIGH_ACCURACY_TIMING_SOURCE)
	if (nrf_modem_gnss_timing_source_set(NRF_MODEM_GNSS_TIMING_SOURCE_TCXO))
	{
		LOG_ERR("Failed to set TCXO timing source");
		return -1;
	}
#endif
#if defined(CONFIG_GNSS_LOW_ACCURACY) || defined(CONFIG_BOARD_THINGY91_NRF9160_NS)
	uint8_t use_case;
	use_case = NRF_MODEM_GNSS_USE_CASE_MULTIPLE_HOT_START | NRF_MODEM_GNSS_USE_CASE_LOW_ACCURACY;
	if (nrf_modem_gnss_use_case_set(use_case) != 0)
	{
		LOG_ERR("Failed to set low accuracy use case");
		return -1;
	}
#endif
	/* Configure GNSS event handler . */
	if (nrf_modem_gnss_event_handler_set(gnss_event_handler) != 0)
	{
		LOG_ERR("Failed to set GNSS event handler");
		return -1;
	}

	if (nrf_modem_gnss_fix_interval_set(CONFIG_TRACKER_PERIODIC_INTERVAL) != 0)
	{
		LOG_ERR("Failed to set GNSS fix interval");
		return -1;
	}

	if (nrf_modem_gnss_fix_retry_set(CONFIG_TRACKER_PERIODIC_TIMEOUT) != 0)
	{
		LOG_ERR("Failed to set GNSS fix retry");
		return -1;
	}

	if (nrf_modem_gnss_start() != 0)
	{
		LOG_ERR("Failed to start GNSS");
		return -1;
	}
	if (nrf_modem_gnss_prio_mode_enable() != 0)
	{
		LOG_ERR("Error setting GNSS priority mode");
		return -1;
	}
	return 0;
}
```

## src/gnss.h
```c
// gnss.h
#ifndef GNSS_H
#define GNSS_H

/* INCLUDES */
#include <zephyr/kernel.h>
#include <nrf_modem_gnss.h>
#include <dk_buttons_and_leds.h>

/* DEFINES */

/* SEMAPHORES */
extern struct k_sem gnss_fix_sem;

/* VARIABLES */
extern struct nrf_modem_gnss_pvt_data_frame current_pvt;
extern struct nrf_modem_gnss_pvt_data_frame last_pvt;
enum tracker_status
{
	status_nolte = DK_LED1,
	status_searching = DK_LED2,
	status_fixed = DK_LED3
};

/* FUNCTION PROTOTYPES */
int gnss_init_and_start(void);

#endif // GNSS_H
```
