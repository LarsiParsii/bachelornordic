## CMakeLists.txt
```
# SPDX-License-Identifier: Apache-2.0

cmake_minimum_required(VERSION 3.20.0)

find_package(Zephyr REQUIRED HINTS $ENV{ZEPHYR_BASE})
project(vessel_unit)

target_sources(app PRIVATE
	src/main.c
	src/coap.c
	src/gnss.c
	src/led_button.c
	src/lte.c
	)
```

## Kconfig
```
# This stems from Nordic Semiconductor's asset tracker sample, with some minor changes

#
# Copyright (c) 2019 Nordic Semiconductor ASA
#
# SPDX-License-Identifier: LicenseRef-Nordic-5-Clause
#

menu "Vessel Unit Configuration"

config DEVICE_VERSION
	string "Version number"
	default "1.0.0"

config COAP_DEVICE_NAME
	string "Device resource name - this will be the device name on the CoAP server"
	default "cali.UnspecifiedUnit"

config COAP_TARGET_NAME
	string "Device resource name - this will be the device name on the CoAP server"
	default "cali.UnspecifiedTarget"

config COAP_TX_RESOURCE
	string "Parent CoAP resource - this is the parent resource of your device resource name"
	default "echo"

config COAP_RX_RESOURCE
	string "Parent CoAP resource - this is the parent resource of your device resource name"
	default "echo"

config COAP_SERVER_HOSTNAME
	string "CoAP server hostname"
	default "californium.eclipseprojects.io"

config COAP_SERVER_PORT
	int "CoAP server port"
	default 5684
	
config COAP_SERVER_PSK
	string "Server PSK"
	default "2e666f726e69756d"

config TRACKER_PERIODIC_INTERVAL
	int "Fix interval for periodic GPS fixes. This determines your tracking frequency"
	range 10 65535
	default 120
	help
	  Fix interval (in seconds) for periodic fixes.

config TRACKER_PERIODIC_TIMEOUT
	int "Fix timeout for periodic GPS fixes"
	range 0 65535
	default 600
	help
	  Fix timeout (in seconds) for periodic fixes.
	  If set to zero, GNSS is allowed to run indefinitely until a valid PVT estimate is produced.

config GNSS_LOW_ACCURACY
	bool "Allow low accuracy fixes."
	help
	  Helps with faster fixes.GNSS demonstrates a looser acceptance criterion for a fix.

config GNSS_HIGH_ACCURACY_TIMING_SOURCE
	bool "Use Crystal oscillator"
	help
	  Use crystal oscillator (TCXO) timing source for the GNSS interface 
	  instead of the default Real time clock (RTC).TCXO has higher power consumption than RTC

endmenu

menu "Zephyr Kernel"
source "Kconfig.zephyr"
endmenu
```

## prj.conf
```kconfig
# Parts of this stems from Nordic Semiconductor's asset tracker sample

CONFIG_DEVICE_VERSION="1.0.0"

# Logging
CONFIG_LOG=y
CONFIG_LOG_PRINTK=y
# Set log level (0 = off, 1 = error, 2 = warning, 3 = info, 4 = debug2)
CONFIG_LOG_MAX_LEVEL=3

# Multithreading
CONFIG_TIMESLICING=y
CONFIG_TIMESLICE_SIZE=10
# Modem thread has priority 0, do not timeslice it
CONFIG_TIMESLICE_PRIORITY=5

# Button and LED support
CONFIG_DK_LIBRARY=y

# Sensors
CONFIG_SENSOR=y

# Newlib
CONFIG_NEWLIB_LIBC=y
CONFIG_FPU=y
CONFIG_NEWLIB_LIBC_FLOAT_PRINTF=y

# Networking
CONFIG_NETWORKING=y
CONFIG_NET_NATIVE=n
CONFIG_NET_SOCKETS_OFFLOAD=y
CONFIG_NET_SOCKETS=y
CONFIG_NET_SOCKETS_POSIX_NAMES=y

# Memory
CONFIG_MAIN_STACK_SIZE=8192
CONFIG_HEAP_MEM_POOL_SIZE=8192

# Modem library
CONFIG_NRF_MODEM_LIB=y
CONFIG_MODEM_KEY_MGMT=y

# LTE link control
CONFIG_LTE_LINK_CONTROL=y
CONFIG_LTE_AUTO_INIT_AND_CONNECT=n
CONFIG_LTE_NETWORK_MODE_LTE_M_GPS=y

# AT commands interface
CONFIG_AT_HOST_LIBRARY=n
CONFIG_UART_INTERRUPT_DRIVEN=y

# CoAP
CONFIG_COAP=y
CONFIG_COAP_DEVICE_NAME="cali.VesselUnit"
CONFIG_COAP_TARGET_NAME="cali.MainUnit1"

# GNSS/GPS
CONFIG_TRACKER_PERIODIC_INTERVAL=120
```

## src/main.c
```c
#include <zephyr/kernel.h>
#include <zephyr/device.h>
#include <zephyr/devicetree.h>
#include <zephyr/logging/log.h>
#include <dk_buttons_and_leds.h>
#include <zephyr/sys/printk.h>

#include "custom_errno.h"
#include "gnss.h"
#include "lte.h"
#include "coap.h"
#include "led_button.h"

LOG_MODULE_REGISTER(main_c_, LOG_LEVEL_DBG);

#define DOWNLOAD_THREAD_PRIORITY 9
#define UPLOAD_THREAD_PRIORITY 8
#define GPS_THREAD_PRIORITY 7
#define STACKSIZE 2048

#define APP_COAP_MAX_MSG_LEN 1280
#define APP_COAP_SEND_MAX_MSG_LEN 128
static uint8_t coap_buf[APP_COAP_MAX_MSG_LEN];			// Holds the CoAP message
static uint8_t coap_buf_rec[APP_COAP_MAX_MSG_LEN];			// Holds the CoAP message
static uint8_t coap_databuf[APP_COAP_SEND_MAX_MSG_LEN]; // Holds the data to send in the CoAP message

struct nrf_modem_gnss_pvt_data_frame vessel_current_pvt;
struct nrf_modem_gnss_pvt_data_frame vessel_last_pvt;
struct nrf_modem_gnss_pvt_data_frame main_unit_current_pvt;
struct nrf_modem_gnss_pvt_data_frame main_unit_last_pvt;
static int resolve_address_lock = 0;
static int sock;
bool shutdown_flag = false;					   // Flag to signal a fault that should shut down the system
volatile bool faux_gnss_fix_requested = false; // Generate fake GPS data for testing purposes
volatile bool download_data = false;		   // Flag to signal that data should be downloaded

// Semaphores included from other files:
// K_SEM_DEFINE(lte_connected, 0, 1) from lte.c
// K_SEM_DEFINE(gnss_fix_sem, 0, 1) from gnss.c

K_THREAD_STACK_DEFINE(download_thread_stack, STACKSIZE);
K_THREAD_STACK_DEFINE(upload_thread_stack, STACKSIZE);
K_THREAD_STACK_DEFINE(gps_thread_stack, STACKSIZE);

struct k_thread download_thread_data;
struct k_thread upload_thread_data;
struct k_thread gnss_thread_data;

k_tid_t download_thread_id;
k_tid_t upload_thread_id;
k_tid_t gnss_thread_id;

K_SEM_DEFINE(sem_lte_busy, 1, 1);
K_SEM_DEFINE(sem_send_new_data, 0, 1);
K_SEM_DEFINE(sem_get_new_data, 0, 1);

void gnss_thread(void *arg1, void *arg2, void *arg3)
{
	while (1)
	{
		if (shutdown_flag)
		{
			// Do any necessary cleanup here before exiting
			break;
		}
		// GNSS is event driven and will give a semaphore when a fix is found.
		// This happens in the gnss_event_handler() function in gnss.c.
		if (faux_gnss_fix_requested)
		{
			setOnboardLed(true);
			createFauxFix(&vessel_current_pvt);
			print_fix_data(&vessel_current_pvt);
			k_sem_give(&sem_send_new_data);	 // Signals that there's updated data to send
			faux_gnss_fix_requested = false; // Reset the flag
		}
		if (download_data == true)
		{
			download_data = false; // Reset the flag
			setOnboardLed(true);
			k_sem_give(&sem_get_new_data); // Signals that there's updated data to send
		}

		k_sleep(K_SECONDS(1));
	}
}

void download_thread(void *arg1, void *arg2, void *arg3)
{
	int err, received;

	while (1)
	{
		if (shutdown_flag)
		{
			lte_lc_power_off();
			LOG_ERR("Shutting down download thread...");
			break;
		}

		if ((k_sem_take(&sem_get_new_data, K_FOREVER) == 0) && (k_sem_take(&sem_lte_busy, K_FOREVER) == 0)) // Wait for data to send
		{
			LOG_INF("Downloading data over LTE\n\r");
			
			err = lte_lc_func_mode_set(LTE_LC_FUNC_MODE_NORMAL);
			if (err != 0)
			{
				LOG_ERR("Failed to activate LTE");
				break;
			}
			LOG_INF("Waiting for LTE connection\n\r");
			k_sem_take(&lte_connected, K_FOREVER); // Wait for the LTE connection to be established
			LOG_INF("LTE connected\n\r");

			if (resolve_address_lock == 0)
			{
				LOG_INF("Resolving the server address\n\r");
				if (server_resolve() != 0)
				{
					LOG_ERR("Failed to resolve server name\n");
					return;
				}
				resolve_address_lock = 1;
			}

			LOG_INF("Downloading Data over LTE\r\n");
			if (server_connect(sock) != 0)
			{
				LOG_ERR("Failed to initialize CoAP client\n");
				return;
			}

			if (client_get_send(sock, coap_buf, sizeof(coap_buf)) != 0)
			{
				LOG_ERR("Failed to send GET request, exit...\n");
				break;
			}
			received = recv(sock, coap_buf_rec, sizeof(coap_buf_rec), 0);

			if (received < 0)
			{
				LOG_ERR("Error reading response\n");
				break;
			}

			if (received == 0)
			{
				LOG_ERR("Disconnected\n");
				break;
			}

			// Handle the response
			err = client_handle_get_response(coap_buf_rec, received);
			if (err < 0)
			{
				LOG_ERR("Invalid response, exit...\n");
				break;
			}

			(void)close(sock);
			err = lte_lc_func_mode_set(LTE_LC_FUNC_MODE_DEACTIVATE_LTE);
			if (err != 0)
			{
				LOG_ERR("Failed to deactivate LTE and enable GNSS functional mode");
				break;
			}

			LOG_INF("Data received successfully\n\r");
			k_sem_give(&sem_lte_busy); // Release the LTE semaphore
			setOnboardLed(false);
		}

		else
		{
			k_sleep(K_MSEC(200));
		}
	}
}


void upload_thread(void *arg1, void *arg2, void *arg3)
{
	int err, received;

	while (1)
	{
		if (shutdown_flag)
		{
			lte_lc_power_off();
			LOG_ERR("Shutting down upload thread...");
			break;
		}

		if ((k_sem_take(&sem_send_new_data, K_FOREVER) == 0) && (k_sem_take(&sem_lte_busy, K_FOREVER) == 0)) // Wait for data to send
		{
			LOG_INF("Sending data over LTE\n\r");
			
			err = lte_lc_func_mode_set(LTE_LC_FUNC_MODE_NORMAL);
			if (err != 0)
			{
				LOG_ERR("Failed to activate LTE");
				break;
			}
			LOG_INF("Waiting for LTE connection\n\r");
			k_sem_take(&lte_connected, K_FOREVER); // Wait for the LTE connection to be established
			LOG_INF("LTE connected\n\r");

			// Send the data to the server
			if (resolve_address_lock == 0)
			{
				LOG_INF("Resolving the server address\n\r");
				if (server_resolve() != 0)
				{
					LOG_ERR("Failed to resolve server name\n");
					return;
				}
				resolve_address_lock = 1;
			}
			LOG_INF("Sending Data over LTE\r\n");
			if (server_connect(sock) != 0)
			{
				LOG_ERR("Failed to initialize CoAP client\n");
				return;
			}

			if (client_post_send(sock, coap_buf, sizeof(coap_buf), coap_databuf, sizeof(coap_databuf),
								 vessel_current_pvt, NULL) != 0)
			{
				LOG_ERR("Failed to send POST request, exit...\n");
				break;
			}
			received = recv(sock, coap_buf, sizeof(coap_buf), 0);

			if (received < 0)
			{
				LOG_ERR("Error reading response\n");
				break;
			}

			if (received == 0)
			{
				LOG_ERR("Disconnected\n");
				break;
			}

			// Read it back
			err = client_handle_get_response(coap_buf, received);
			if (err < 0)
			{
				LOG_ERR("Invalid response, exit...\n");
				break;
			}

			(void)close(sock);
			err = lte_lc_func_mode_set(LTE_LC_FUNC_MODE_DEACTIVATE_LTE);
			if (err != 0)
			{
				LOG_ERR("Failed to decativate LTE and enable GNSS functional mode");
				break;
			}

			LOG_INF("Data transmitted and readback successfull\n\r");
			k_sem_give(&sem_lte_busy); // Release the LTE semaphore
			setOnboardLed(false);
		}

		else
		{
			k_sleep(K_MSEC(200));
		}
	}
}

void main(void)
{
	LOG_INF("Vessel Unit Version %s started\n", CONFIG_DEVICE_VERSION);
	int err;

	err = led_button_init();
	if (err)
	{
		LOG_ERR("Failed to initialize LEDs and buttons: %d\n", err);
		return;
	}
	setOnboardLed(false);
	
	// Setup SEC_TAG_DOWNLOAD and SEC_TAG_UPLOAD
	setup_sec_tags();
	
	
	modem_configure();

	LOG_INF("Starting GNSS....");
	err = gnss_init_and_start();
	if (!err)
	{
		LOG_INF("GNSS started successfully\n");
	}
	k_sem_give(&sem_lte_busy); // Release the LTE semaphore

	download_thread_id = k_thread_create(&download_thread_data, download_thread_stack,
										 STACKSIZE, download_thread, NULL, NULL, NULL,
										 UPLOAD_THREAD_PRIORITY, 0, K_NO_WAIT);

	upload_thread_id = k_thread_create(&upload_thread_data, upload_thread_stack,
									   STACKSIZE, upload_thread, NULL, NULL, NULL,
									   UPLOAD_THREAD_PRIORITY, 0, K_NO_WAIT);

	gnss_thread_id = k_thread_create(&gnss_thread_data, gps_thread_stack,
									 STACKSIZE, gnss_thread, NULL, NULL, NULL,
									 GPS_THREAD_PRIORITY, 0, K_NO_WAIT);
}
```

## src/coap.c
```c
#include "coap.h"
#include <stdint.h>
#include <stdio.h>
#include <nrf_modem_gnss.h>
#include <zephyr/net/coap.h>
#include <zephyr/net/socket.h>
#include <zephyr/random/rand32.h>
#include <modem/modem_key_mgmt.h>
#include <zephyr/net/tls_credentials.h>

LOG_MODULE_REGISTER(CoAP, LOG_LEVEL_DBG);

/* VARIABLES */
static uint16_t next_token;
static struct sockaddr_storage server;

/* FUNCTION DEFINITIONS */

/**@brief Resolves the configured hostname. */
int server_resolve(void)
{
	int err;
	struct addrinfo *result;
	struct addrinfo hints = {
		.ai_family = AF_INET,
		.ai_socktype = SOCK_DGRAM};
	char ipv4_addr[NET_IPV4_ADDR_LEN];

	err = getaddrinfo(CONFIG_COAP_SERVER_HOSTNAME, NULL, &hints, &result);
	if (err != 0)
	{
		LOG_ERR("ERROR: getaddrinfo failed %d\n", err);
		return -EIO;
	}

	if (result == NULL)
	{
		LOG_ERR("ERROR: Address not found\n");
		return -ENOENT;
	}

	/* IPv4 Address. */
	struct sockaddr_in *server4 = ((struct sockaddr_in *)&server);

	server4->sin_addr.s_addr =
		((struct sockaddr_in *)result->ai_addr)->sin_addr.s_addr;
	server4->sin_family = AF_INET;
	server4->sin_port = htons(CONFIG_COAP_SERVER_PORT);

	inet_ntop(AF_INET, &server4->sin_addr.s_addr, ipv4_addr,
			  sizeof(ipv4_addr));
	LOG_INF("IPv4 Address found %s\n", ipv4_addr);

	/* Free the address. */
	freeaddrinfo(result);

	return 0;
}

/**@brief Initialize the CoAP client */
int server_connect(int sock)
{
	int err;

	sock = socket(AF_INET, SOCK_DGRAM, IPPROTO_DTLS_1_2);
	if (sock < 0)
	{
		LOG_ERR("Failed to create CoAP socket: %d.\n", errno);
		return -errno;
	}

	int verify;
	sec_tag_t sec_tag_list[] = {SEC_TAG};

	enum
	{
		NONE = 0,
		OPTIONAL = 1,
		REQUIRED = 2,
	};

	verify = REQUIRED;

	err = setsockopt(sock, SOL_TLS, TLS_PEER_VERIFY, &verify, sizeof(verify));
	if (err)
	{
		LOG_ERR("Failed to setup peer verification, errno %d\n", errno);
		return -errno;
	}

	err = setsockopt(sock, SOL_TLS, TLS_HOSTNAME, CONFIG_COAP_SERVER_HOSTNAME,
					 strlen(CONFIG_COAP_SERVER_HOSTNAME));
	if (err)
	{
		LOG_ERR("Failed to setup TLS hostname (%s), errno %d\n",
				CONFIG_COAP_SERVER_HOSTNAME, errno);
		return -errno;
	}

	err = setsockopt(sock, SOL_TLS, TLS_SEC_TAG_LIST, sec_tag_list,
					 sizeof(sec_tag_t) * ARRAY_SIZE(sec_tag_list));
	if (err)
	{
		LOG_ERR("Failed to setup socket security tag, errno %d\n", errno);
		return -errno;
	}

	int cache = TLS_SESSION_CACHE_ENABLED;
	err = setsockopt(sock, SOL_TLS, TLS_SESSION_CACHE, &cache,
					 sizeof(cache));
	if (err)
	{
		LOG_ERR("Failed to setup TLS session cache, errno %d\n", errno);
		return -errno;
	}

	err = connect(sock, (struct sockaddr *)&server,
				  sizeof(struct sockaddr_in));
	if (err < 0)
	{
		LOG_ERR("Connect failed : %d\n", errno);
		return -errno;
	}

	/* Randomize token. */
	next_token = sys_rand32_get();

	return 0;
}

int client_get_send(int sock, uint8_t *buf, size_t buf_size)
{
	int err;
	struct coap_packet request;

	next_token++;

	err = coap_packet_init(&request, buf, buf_size,
						   APP_COAP_VERSION, COAP_TYPE_CON,
						   sizeof(next_token), (uint8_t *)&next_token,
						   COAP_METHOD_GET, coap_next_id());
	if (err < 0)
	{
		LOG_ERR("Failed to create CoAP request, %d\n", err);
		return err;
	}

	err = coap_packet_append_option(&request, COAP_OPTION_URI_PATH,
									(uint8_t *)CONFIG_COAP_RX_RESOURCE,
									strlen(CONFIG_COAP_RX_RESOURCE));
	if (err < 0)
	{
		LOG_ERR("Failed to encode CoAP option, %d\n", err);
		return err;
	}

	err = send(sock, request.data, request.offset, 0);
	if (err < 0)
	{
		LOG_ERR("Failed to send CoAP request, %d\n", errno);
		return -errno;
	}

	LOG_INF("CoAP request sent: token 0x%04x\n", next_token);

	return 0;
}


/**@brief Handles responses from the remote CoAP server. */
int client_handle_get_response(uint8_t *buf, int received)
{
	LOG_INF("Received %d bytes from server\n", received);
	int err;
	struct coap_packet reply;
	const uint8_t *payload;
	uint16_t payload_len;
	uint8_t token[8];
	uint16_t token_len;
	static uint8_t temp_buf[256];

	err = coap_packet_parse(&reply, buf, received, NULL, 0);
	if (err < 0)
	{
		LOG_ERR("Malformed response received: %d\n", err);
		return err;
	}

	payload = coap_packet_get_payload(&reply, &payload_len);
	token_len = coap_header_get_token(&reply, token);

	if ((token_len != sizeof(next_token)) ||
		(memcmp(&next_token, token, sizeof(next_token)) != 0))
	{
		LOG_ERR("Invalid token received: 0x%02x%02x\n",
				token[1], token[0]);
		return 0;
	}

	if (payload_len > 0)
	{
		snprintf(temp_buf, MIN(payload_len + 1, sizeof(temp_buf)), "%s", payload);
	}
	else
	{
		strcpy(temp_buf, "EMPTY");
	}
	
	LOG_INF("CoAP response: Code 0x%x, Token 0x%02x%02x, Payload: %s, Bytes: %d\n",
			coap_header_get_code(&reply), token[1], token[0], (char*)temp_buf, MIN(payload_len + 1, sizeof(temp_buf)));
	return 0;
}

int client_post_send(int sock, uint8_t *buf, size_t buf_size, uint8_t *databuf, size_t databuf_size,
					 struct nrf_modem_gnss_pvt_data_frame vessel_current_pvt, bool mob_value)
{
	int err, ret;
	struct coap_packet request;

	next_token++;

	err = coap_packet_init(&request, buf, buf_size,
						   APP_COAP_VERSION, COAP_TYPE_CON,
						   sizeof(next_token), (uint8_t *)&next_token,
						   COAP_METHOD_POST, coap_next_id());
	if (err < 0)
	{
		LOG_ERR("Failed to create CoAP request, %d\n", err);
		return err;
	}

	err = coap_packet_append_option(&request, COAP_OPTION_URI_PATH,
									(uint8_t *)CONFIG_COAP_TX_RESOURCE,
									strlen(CONFIG_COAP_TX_RESOURCE));
	if (err < 0)
	{
		LOG_ERR("Failed to encode CoAP option, %d\n", err);
		return err;
	}

	err = coap_append_option_int(&request, COAP_OPTION_CONTENT_FORMAT,
								 COAP_CONTENT_FORMAT_TEXT_PLAIN);
	if (err < 0)
	{
		LOG_ERR("Failed to encode CoAP CONTENT_FORMAT option, %d", err);
		return err;
	}

	err = coap_packet_append_option(&request, COAP_OPTION_URI_QUERY,
									(uint8_t *)"keep",
									strlen("keep"));
	if (err < 0)
	{
		LOG_ERR("Failed to encode CoAP URI-QUERY option 'keep', %d", err);
		return err;
	}

	err = coap_packet_append_payload_marker(&request);
	if (err < 0)
	{
		LOG_ERR("Failed to append payload marker, %d\n", err);
		return err;
	}

	ret = snprintf(databuf, databuf_size, "%.06f,%.06f\n%.01f m\n%04u-%02u-%02u %02u:%02u:%02u\n%d",
				   vessel_current_pvt.latitude, vessel_current_pvt.longitude, vessel_current_pvt.accuracy, vessel_current_pvt.datetime.year, vessel_current_pvt.datetime.month, vessel_current_pvt.datetime.day,
				   vessel_current_pvt.datetime.hour, vessel_current_pvt.datetime.minute, vessel_current_pvt.datetime.seconds, mob_value);
	if (err < 0)
	{
		LOG_ERR("snprintf failed to format string, %d\n", err);
		return err;
	}
	err = coap_packet_append_payload(&request, (uint8_t *)databuf, ret);
	if (err < 0)
	{
		LOG_ERR("Failed to append payload, %d\n", err);
		return err;
	}

	err = send(sock, request.data, request.offset, 0);
	if (err < 0)
	{
		LOG_ERR("Failed to send CoAP request, %d\n", errno);
		return -errno;
	}

	LOG_INF("CoAP request sent: token 0x%04x\n", next_token);

	return 0;
}

void setup_sec_tags(void)
{
	LOG_INF("Initializing SEC_TAGS...\n");
	int err;
	err = modem_key_mgmt_write(SEC_TAG, MODEM_KEY_MGMT_CRED_TYPE_IDENTITY, CONFIG_COAP_DEVICE_NAME, strlen(CONFIG_COAP_DEVICE_NAME));
	if (err)
	{
		LOG_ERR("Failed to write identity: %d\n", err);
		return;
	}
	err = modem_key_mgmt_write(SEC_TAG, MODEM_KEY_MGMT_CRED_TYPE_PSK, CONFIG_COAP_SERVER_PSK, strlen(CONFIG_COAP_SERVER_PSK));
	if (err)
	{
		LOG_ERR("Failed to write identity: %d\n", err);
		return;
	}
}
```

## src/coap.h
```c
#ifndef COAP_H
#define COAP_H

/* INCLUDES */
#include <stdint.h>
#include <zephyr/net/socket.h>
#include <nrf_modem_gnss.h>

/* DEFINES */
#define APP_COAP_SEND_INTERVAL_MS 60000
#define APP_COAP_VERSION 1

#define SEC_TAG 12

/* VARIABLES */

/* FUNCTION PROTOTYPES */
int server_resolve(void);
int server_connect(int sock);
int client_get_send(int sock, uint8_t *buf, size_t buf_size);
int client_handle_get_response(uint8_t *buf, int received);
int client_post_send(int sock, uint8_t *buf, size_t, uint8_t *sendbuf, size_t sendbuf_size,
					 struct nrf_modem_gnss_pvt_data_frame vessel_current_pvt, bool mob_event);
void setup_sec_tags(void);

#endif // COAP_H
```

## src/gnss.c
```c
#include "gnss.h"
#include "led_button.h"
#include <stdio.h>
#include <zephyr/logging/log.h>
#include <nrf_modem_gnss.h>
#include <zephyr/random/rand32.h>

LOG_MODULE_REGISTER(GNSS, LOG_LEVEL_DBG);

/* VARIABLES */

/* FUNCTION DEFINITIONS */
void print_fix_data(struct nrf_modem_gnss_pvt_data_frame *pvt_data)
{
	printk("Latitude:       %.06f\n", pvt_data->latitude);
	printk("Longitude:      %.06f\n", pvt_data->longitude);
	printk("Altitude:       %.01f m\n", pvt_data->altitude);
	printk("Time (UTC):     %02u:%02u:%02u.%03u\n",
		   pvt_data->datetime.hour,
		   pvt_data->datetime.minute,
		   pvt_data->datetime.seconds,
		   pvt_data->datetime.ms);
}

static void gnss_event_handler(int event)
{
	int retval;
	switch (event)
	{
	case NRF_MODEM_GNSS_EVT_PVT:
		LOG_DBG("Searching for GNSS Satellites....\n\r");
		break;
	case NRF_MODEM_GNSS_EVT_FIX:
		LOG_INF("GNSS fix event\n\r");
		break;
	case NRF_MODEM_GNSS_EVT_PERIODIC_WAKEUP:
		LOG_INF("GNSS woke up in periodic mode\n\r");
		break;
	case NRF_MODEM_GNSS_EVT_BLOCKED:
		LOG_INF("GNSS is blocked by LTE event\n\r");
		break;
	case NRF_MODEM_GNSS_EVT_SLEEP_AFTER_FIX:
		LOG_INF("GNSS enters sleep because fix was achieved in periodic mode\n\r");
		retval = nrf_modem_gnss_read(&vessel_last_pvt, sizeof(vessel_last_pvt), NRF_MODEM_GNSS_DATA_PVT);
		if (retval == 0)
		{
			setOnboardLed(true);
			vessel_current_pvt = vessel_last_pvt;
			print_fix_data(&vessel_current_pvt);
			k_sem_give(&sem_send_new_data);
		}
		break;
	case NRF_MODEM_GNSS_EVT_SLEEP_AFTER_TIMEOUT:
		LOG_DBG("GNSS enters sleep because fix retry timeout was reached\n\r");
		break;

	default:

		break;
	}
}

int gnss_init_and_start(void)
{
	int err;
#if defined(CONFIG_GNSS_HIGH_ACCURACY_TIMING_SOURCE)
	err = nrf_modem_gnss_timing_source_set(NRF_MODEM_GNSS_TIMING_SOURCE_TCXO);
	if (err < 0)
	{
		LOG_ERR("Failed to set TCXO timing source: %d", err);
		return err;
	}
#endif
#if defined(CONFIG_GNSS_LOW_ACCURACY) || defined(CONFIG_BOARD_THINGY91_NRF9160_NS)
	uint8_t use_case;
	use_case = NRF_MODEM_GNSS_USE_CASE_MULTIPLE_HOT_START | NRF_MODEM_GNSS_USE_CASE_LOW_ACCURACY;
	err = nrf_modem_gnss_use_case_set(use_case);
	if (err < 0)
	{
		LOG_ERR("Failed to set low accuracy use case: %d", err);
		return err;
	}
#endif
	/* Configure GNSS event handler . */
	err = nrf_modem_gnss_event_handler_set(gnss_event_handler);
	if (err < 0)
	{
		LOG_ERR("Failed to set GNSS event handler: %d", err);
		return err;
	}
	
	err = nrf_modem_gnss_fix_interval_set(CONFIG_TRACKER_PERIODIC_INTERVAL);
	if (err < 0)
	{
		LOG_ERR("Failed to set GNSS fix interval: %d", err);
		return err;
	}
	
	err = nrf_modem_gnss_fix_retry_set(CONFIG_TRACKER_PERIODIC_TIMEOUT);
	if (err < 0)
	{
		LOG_ERR("Failed to set GNSS fix retry: %d", err);
		return err;
	}
	
	err = nrf_modem_gnss_start();
	if (err < 0)
	{
		LOG_ERR("Failed to start GNSS");
		return err;
	}
	
	err = nrf_modem_gnss_prio_mode_disable();		// DISABLED GNSS PRIORITY MODE
	if (err < 0)
	{
		LOG_ERR("Error setting GNSS priority mode");
		return err;
	}
	return 0;
}

double generate_random_double(double min, double max)
{
	uint32_t randNum = sys_rand32_get();
	double fraction = ((double)randNum) / UINT32_MAX; // Normalize to [0, 1]
	return min + fraction * (max - min);			  // Scale to [min, max]
}

void createFauxFix(struct nrf_modem_gnss_pvt_data_frame *pvt_data)
{
	LOG_INF("Faux GNSS fix requested");

	pvt_data->latitude = generate_random_double(-90, 90);
	pvt_data->longitude = generate_random_double(-180, 180);
	pvt_data->altitude = generate_random_double(0, 1000);
	pvt_data->accuracy = generate_random_double(0, 100);
	pvt_data->datetime.day = sys_rand32_get() % 31;
	pvt_data->datetime.month = sys_rand32_get() % 12;
	pvt_data->datetime.year = 2023;
	pvt_data->datetime.hour = sys_rand32_get() % 24;
	pvt_data->datetime.minute = sys_rand32_get() % 60;
	pvt_data->datetime.seconds = sys_rand32_get() % 60;
	pvt_data->datetime.ms = sys_rand32_get() % 1000;
}
```

## src/gnss.h
```c
// gnss.h
#ifndef GNSS_H
#define GNSS_H

/* INCLUDES */
#include <zephyr/kernel.h>
#include <nrf_modem_gnss.h>
#include <dk_buttons_and_leds.h>

/* DEFINES */

/* SEMAPHORES */
extern struct k_sem sem_send_new_data;

/* VARIABLES */
extern struct nrf_modem_gnss_pvt_data_frame vessel_current_pvt;
extern struct nrf_modem_gnss_pvt_data_frame vessel_last_pvt;
extern struct nrf_modem_gnss_pvt_data_frame main_unit_current_pvt;
extern struct nrf_modem_gnss_pvt_data_frame main_unit_last_pvt;

/* FUNCTION PROTOTYPES */
void print_fix_data(struct nrf_modem_gnss_pvt_data_frame *pvt_data);
int gnss_init_and_start(void);
void createFauxFix(struct nrf_modem_gnss_pvt_data_frame *pvt_data);

#endif // GNSS_H
```

## src/led_button.c
```c
#include "led_button.h"
#include "custom_errno.h"
#include <zephyr/kernel.h>
#include <zephyr/drivers/gpio.h>
#include <zephyr/device.h>
#include <zephyr/devicetree.h>
#include <zephyr/sys/printk.h>
#include <zephyr/logging/log.h>

LOG_MODULE_REGISTER(led_button, LOG_LEVEL_DBG);

#define ONBOARD_LED_NODE DT_NODELABEL(led0)
#define BLUE_LED_NODE DT_NODELABEL(blueled)
#define BUTTON1_NODE DT_NODELABEL(nrf91_btn_1)
#define BUTTON2_NODE DT_NODELABEL(nrf91_btn_2)

static const struct gpio_dt_spec onboard_led = GPIO_DT_SPEC_GET(ONBOARD_LED_NODE, gpios);
static const struct gpio_dt_spec blue_led = GPIO_DT_SPEC_GET(BLUE_LED_NODE, gpios);
static const struct gpio_dt_spec button1 = GPIO_DT_SPEC_GET(BUTTON1_NODE, gpios);
static const struct gpio_dt_spec button2 = GPIO_DT_SPEC_GET(BUTTON2_NODE, gpios);

/* Interrupt callback functions */
// Button 1 callback
void button1_pressed(const struct device *dev, struct gpio_callback *cb, uint32_t pins)
{	
    LOG_DBG("Button 1 pressed\n");
	faux_gnss_fix_requested = true;
}

// Button 2 callback
void button2_pressed(const struct device *dev, struct gpio_callback *cb, uint32_t pins)
{	
    LOG_DBG("Button 2 pressed\n");
    gpio_pin_toggle_dt(&blue_led);
    download_data = true;
}

static struct gpio_callback button1_cb_data;
static struct gpio_callback button2_cb_data;

int led_button_init(void)
{
	int ret;
	LOG_INF("Initializing LEDs and buttons\n");
	if (!device_is_ready(onboard_led.port))
	{
		LOG_ERR("LED0 device not ready\n");
		return -EIONOTREADY;
	}
	if (!device_is_ready(blue_led.port))
	{
		LOG_ERR("BLUE_LED device not ready\n");
		return -EIONOTREADY;
	}
	if (!device_is_ready(button1.port))
	{
		LOG_ERR("BUTTON1 device not ready\n");
		return -EIONOTREADY;
	}
	if (!device_is_ready(button2.port))
	{
		LOG_ERR("BUTTON2 device not ready\n");
		return -EIONOTREADY;
	}
	ret = gpio_pin_configure_dt(&onboard_led, GPIO_OUTPUT_ACTIVE);
	if (ret < 0)
	{
		LOG_ERR("Error %d: failed to configure LED0\n", ret);
		return ret;
	}
	ret = gpio_pin_configure_dt(&blue_led, GPIO_OUTPUT_ACTIVE);
	if (ret < 0)
	{
		LOG_ERR("Error %d: failed to configure BLUE_LED\n", ret);
		return ret;
	}
	ret = gpio_pin_configure_dt(&button1, GPIO_INPUT | GPIO_PULL_UP );
	if (ret < 0)
	{
		LOG_ERR("Error %d: failed to configure BUTTON1\n", ret);
		return ret;
	}
	ret = gpio_pin_configure_dt(&button2, GPIO_INPUT | GPIO_PULL_UP);
	if (ret < 0)
	{
		LOG_ERR("Error %d: failed to configure BUTTON2\n", ret);
		return ret;
	}
	
	// Set up the button callbacks
	ret = gpio_pin_interrupt_configure_dt(&button1, GPIO_INT_EDGE_TO_ACTIVE);
	if (ret < 0)
	{
		LOG_ERR("Error %d: failed to configure BUTTON1 interrupt\n", ret);
		return ret;
	}
	
	ret = gpio_pin_interrupt_configure_dt(&button2, GPIO_INT_EDGE_TO_ACTIVE);
	if (ret < 0)
	{
		LOG_ERR("Error %d: failed to configure BUTTON2 interrupt\n", ret);
		return ret;
	}
	gpio_init_callback(&button1_cb_data, button1_pressed, BIT(button1.pin));
    gpio_add_callback(button1.port, &button1_cb_data);
	
    gpio_init_callback(&button2_cb_data, button2_pressed, BIT(button2.pin));
    gpio_add_callback(button2.port, &button2_cb_data);
	
	return 0;
}

// A more descriptive name for the function
static bool readPin(const struct gpio_dt_spec *button_spec)
{
	return gpio_pin_get_dt(button_spec);
}

bool readButton0(void)
{
	return readPin(&button1);
}

bool readButton1(void)
{
	return readPin(&button2);
}

void setOnboardLed(bool state)
{
	gpio_pin_set_dt(&onboard_led, (int)state);
}

void setBlueLed(bool state)
{
	gpio_pin_set_dt(&blue_led, (int)state);
}
```

## src/led_button.h
```c
#ifndef led_button_H
#define led_button_H

#include <zephyr/kernel.h>

/* Function declarations */
int led_button_init(void);
bool readButton0(void);
bool readButton1(void);
void setOnboardLed(bool state);
void setBlueLed(bool state);

extern volatile bool faux_gnss_fix_requested;
extern volatile bool download_data;
extern k_tid_t download_thread_id;

#endif  // led_button_H
```

## src/lte.h
```c
#ifndef LTE_H
#define LTE_H

/* INCLUDES */
#include <zephyr/kernel.h>
#include <modem/lte_lc.h>

/* DEFINES */

/* SEMAPHORES */
extern struct k_sem lte_connected;

/* VARIABLES */

/* FUNCTION PROTOTYPES */
void modem_configure(void);

#endif // LTE_H
```
