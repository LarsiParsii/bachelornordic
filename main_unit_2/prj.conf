## CMakeLists.txt
```
# SPDX-License-Identifier: Apache-2.0

cmake_minimum_required(VERSION 3.20.0)

find_package(Zephyr REQUIRED HINTS $ENV{ZEPHYR_BASE})
project(coap_gnss_test)

target_sources(app PRIVATE
	src/main.c
	src/coap.c
	src/gnss.c
	src/lte.c
	src/sensors.c
	)
```

## Kconfig
```
# This stems from Nordic Semiconductor's asset tracker sample, with only minor changes

#
# Copyright (c) 2019 Nordic Semiconductor ASA
#
# SPDX-License-Identifier: LicenseRef-Nordic-5-Clause
#

menu "Main Unit Configuration"

config TRACKER_VERSION_MAJOR
	int "Major verison number"
	default 0

config TRACKER_VERSION_MINOR
	int "Minor verison number"
	default 2

config TRACKER_VERSION_PATCH
	int "Patch verison number"
	default 1

config COAP_DEVICE_NAME
	string "Device resource name - this will be the device name on the CoAP server"
	default "cali.MainUnit"

config COAP_POST_RESOURCE
	string "Parent CoAP resource - this is the parent resource of your device resource name"
	default "echo"

config COAP_SERVER_HOSTNAME
	string "CoAP server hostname"
	default "californium.eclipseprojects.io"

config COAP_SERVER_PORT
	int "CoAP server port"
	default 5684
	
config COAP_SERVER_PSK
	string "Server PSK"
	default "2e666f726e69756d"

config TRACKER_PERIODIC_INTERVAL
	int "Fix interval for periodic GPS fixes. This determines your tracking frequency"
	range 10 65535
	default 120
	help
	  Fix interval (in seconds) for periodic fixes.

config TRACKER_PERIODIC_TIMEOUT
	int "Fix timeout for periodic GPS fixes"
	range 0 65535
	default 600
	help
	  Fix timeout (in seconds) for periodic fixes.
	  If set to zero, GNSS is allowed to run indefinitely until a valid PVT estimate is produced.

config GNSS_LOW_ACCURACY
	bool "Allow low accuracy fixes."
	help
	  Helps with faster fixes.GNSS demonstrates a looser acceptance criterion for a fix.

config GNSS_HIGH_ACCURACY_TIMING_SOURCE
	bool "Use Crystal oscillator"
	help
	  Use crystal oscillator (TCXO) timing source for the GNSS interface 
	  instead of the default Real time clock (RTC).TCXO has higher power consumption than RTC

endmenu

menu "Zephyr Kernel"
source "Kconfig.zephyr"
endmenu
```

## prj.conf
```kconfig
# Parts of this stems from Nordic Semiconductor's asset tracker sample

# Logging
CONFIG_LOG=y
CONFIG_LOG_PRINTK=y

# Multithreading
CONFIG_TIMESLICING=y
CONFIG_TIMESLICE_SIZE=10
# Modem thread has priority 0, do not timeslice it
CONFIG_TIMESLICE_PRIORITY=5

# Button and LED support
CONFIG_DK_LIBRARY=y

# Sensors
CONFIG_SENSOR=y

# Newlib
CONFIG_NEWLIB_LIBC=y
CONFIG_FPU=y
CONFIG_NEWLIB_LIBC_FLOAT_PRINTF=y

# Networking
CONFIG_NETWORKING=y
CONFIG_NET_NATIVE=n
CONFIG_NET_SOCKETS_OFFLOAD=y
CONFIG_NET_SOCKETS=y
CONFIG_NET_SOCKETS_POSIX_NAMES=y

# Memory
CONFIG_MAIN_STACK_SIZE=8192
CONFIG_HEAP_MEM_POOL_SIZE=8192

# Modem library
CONFIG_NRF_MODEM_LIB=y
CONFIG_MODEM_KEY_MGMT=y

# LTE link control
CONFIG_LTE_LINK_CONTROL=y
CONFIG_LTE_AUTO_INIT_AND_CONNECT=n
CONFIG_LTE_NETWORK_MODE_LTE_M_GPS=y

# AT commands interface
CONFIG_AT_HOST_LIBRARY=n
CONFIG_UART_INTERRUPT_DRIVEN=y

# CoAP
CONFIG_COAP=y

# GNSS/GPS
CONFIG_TRACKER_PERIODIC_INTERVAL=30
CONFIG_GNSS_LOW_ACCURACY=y

# # Logging
# CONFIG_LOG=y
# CONFIG_LOG_PRINTK=y

# # Button and LED support
# CONFIG_DK_LIBRARY=y

# # Newlib
# CONFIG_NEWLIB_LIBC=y
# CONFIG_FPU=y
# CONFIG_NEWLIB_LIBC_FLOAT_PRINTF=y

# # Networking
# CONFIG_NETWORKING=y
# CONFIG_NET_NATIVE=n
# CONFIG_NET_SOCKETS_OFFLOAD=y
# CONFIG_NET_SOCKETS=y
# CONFIG_NET_SOCKETS_POSIX_NAMES=y

# # Memory
# CONFIG_MAIN_STACK_SIZE=8192
# CONFIG_HEAP_MEM_POOL_SIZE=8192

# # Modem library
# CONFIG_NRF_MODEM_LIB=y
# CONFIG_MODEM_KEY_MGMT=y

# # LTE link control
# CONFIG_LTE_LINK_CONTROL=y
# CONFIG_LTE_AUTO_INIT_AND_CONNECT=n
# CONFIG_LTE_NETWORK_MODE_LTE_M_GPS=y

# # AT commands interface
# CONFIG_AT_HOST_LIBRARY=n
# CONFIG_UART_INTERRUPT_DRIVEN=y

# # CoAP
# CONFIG_COAP=y

# # GNSS/GPS
# CONFIG_TRACKER_PERIODIC_INTERVAL=30
# CONFIG_GNSS_LOW_ACCURACY=y
```

## src/main.c
```c
#include <zephyr/kernel.h>
#include <modem/modem_key_mgmt.h>
#include <zephyr/logging/log.h>
#include <dk_buttons_and_leds.h>

#include "gnss.h"
#include "lte.h"
#include "coap.h"
#include "sensors.h"
LOG_MODULE_REGISTER(main_c, LOG_LEVEL_INF);

#define APP_COAP_MAX_MSG_LEN 1280
#define APP_COAP_SEND_MAX_MSG_LEN 64

enum tracker_status device_status;
static uint8_t coap_buf[APP_COAP_MAX_MSG_LEN];
static uint8_t coap_sendbuf[APP_COAP_SEND_MAX_MSG_LEN];
struct nrf_modem_gnss_pvt_data_frame current_pvt;
struct nrf_modem_gnss_pvt_data_frame last_pvt;
static int resolve_address_lock = 0;
static int sock;
bool faux_gnss_fix_requested = false; // Generate fake GPS data for testing purposes
sensors_s sensors;


static void button_handler(uint32_t button_state, uint32_t has_changed)
{
	static bool toogle = 1;
	if (has_changed & DK_BTN1_MSK && button_state & DK_BTN1_MSK)
	{
		if (toogle == 1)
		{
			dk_set_led_on(device_status);
		}
		else
		{
			dk_set_led_off(DK_LED1);
			dk_set_led_off(DK_LED2);
			dk_set_led_off(DK_LED3);
		}
		toogle = !toogle;
	}
	if (has_changed & DK_BTN2_MSK && button_state & DK_BTN2_MSK)
	{
		LOG_INF("Fake GNSS Fix Requested\n\r");
		faux_gnss_fix_requested = true;
	}
}

void sensor_thread(void *arg1, void *arg2, void *arg3)
{
	int err;
	// Initialize the sensors
	err = sensors_init(&sensors);
	/*
	if (err != 0)
	{

		return;
	}
	*/

	// Sensor data read and print loop
	while (1)
	{
		read_sensors(&sensors);
		LOG_INF("BME280: Temperature: %d.%06d C, Pressure: %d.%06d hPa, Humidity: %d.%06d %%RH\n",
				sensors.bme280.temperature.val1, sensors.bme280.temperature.val2, sensors.bme280.pressure.val1, sensors.bme280.pressure.val2,
				sensors.bme280.humidity.val1, sensors.bme280.humidity.val2);

		if (sensors.bme280.humidity.val1 > 50)
		{
			LOG_WRN("MOB ALERT!");
			k_sem_give(&sem_send_data);
		}

		k_sleep(K_SECONDS(3));
	}
}

void gps_thread(void *arg1, void *arg2, void *arg3)
{
	while (1)
	{
		// GNSS is event driven and will give a semaphore when a fix is found.
		// This happens in the gnss_event_handler() function in gnss.c.
		if (faux_gnss_fix_requested)
		{
			createFauxFix();
			k_sem_give(&sem_send_data);		 // Signals that there's updated data to send
			faux_gnss_fix_requested = false; // Reset the flag
		}
		k_sleep(K_SECONDS(10));
	}
}

void main(void)
{
	int err, received;
	LOG_INF("Main Unit Version %d.%d.%d started\n", CONFIG_TRACKER_VERSION_MAJOR, CONFIG_TRACKER_VERSION_MINOR, CONFIG_TRACKER_VERSION_PATCH);

	LOG_INF("Starting GNSS....");
	gnss_init_and_start();
	
	err = modem_key_mgmt_write(SEC_TAG, MODEM_KEY_MGMT_CRED_TYPE_IDENTITY, CONFIG_COAP_DEVICE_NAME, strlen(CONFIG_COAP_DEVICE_NAME));
	if (err)
	{
		LOG_ERR("Failed to write identity: %d\n", err);
		return;
	}

	err = modem_key_mgmt_write(SEC_TAG, MODEM_KEY_MGMT_CRED_TYPE_PSK, CONFIG_COAP_SERVER_PSK, strlen(CONFIG_COAP_SERVER_PSK));
	if (err)
	{
		LOG_ERR("Failed to write identity: %d\n", err);
		return;
	}

	err = dk_leds_init();
	if (err)
	{
		LOG_ERR("Failed to initlize the LEDs Library");
	}
	device_status = status_nolte;

	modem_configure();

	err = dk_buttons_init(button_handler);
	if (err)
	{
		LOG_ERR("Failed to initlize button handler: %d\n", err);
		return;
	}

	while (1)
	{
		err = lte_lc_func_mode_set(LTE_LC_FUNC_MODE_NORMAL);
		if (err != 0)
		{
			LOG_ERR("Failed to activate LTE");
			break;
		}
		k_sem_take(&lte_connected, K_FOREVER);
		if (resolve_address_lock == 0)
		{
			LOG_INF("Resolving the server address\n\r");
			if (server_resolve() != 0)
			{
				LOG_ERR("Failed to resolve server name\n");
				return;
			}
			resolve_address_lock = 1;
		}
		LOG_INF("Sending Data over LTE\r\n");
		if (server_connect(sock) != 0)
		{
			LOG_ERR("Failed to initialize CoAP client\n");
			return;
		}

		if (client_post_send(sock, coap_buf, sizeof(coap_buf), coap_sendbuf, sizeof(coap_sendbuf),
							 current_pvt, last_pvt) != 0)
		{
			LOG_ERR("Failed to send GET request, exit...\n");
			break;
		}
		received = recv(sock, coap_buf, sizeof(coap_buf), 0);

		if (received < 0)
		{
			LOG_ERR("Error reading response\n");
			break;
		}

		if (received == 0)
		{
			LOG_ERR("Disconnected\n");
			break;
		}
		err = client_handle_get_response(coap_buf, received);
		if (err < 0)
		{
			LOG_ERR("Invalid response, exit...\n");
			break;
		}

		(void)close(sock);
		err = lte_lc_func_mode_set(LTE_LC_FUNC_MODE_DEACTIVATE_LTE);
		if (err != 0)
		{
			LOG_ERR("Failed to decativate LTE and enable GNSS functional mode");
			break;
		}
	}
	device_status = status_nolte;
	lte_lc_power_off();
	LOG_ERR("Error occoured. Shutting down modem");
}
```

## src/gnss.h
```c
// gnss.h
#ifndef GNSS_H
#define GNSS_H

/* INCLUDES */
#include <zephyr/kernel.h>
#include <nrf_modem_gnss.h>
#include <dk_buttons_and_leds.h>

/* DEFINES */

/* SEMAPHORES */
extern struct k_sem sem_send_data;

/* VARIABLES */
extern struct nrf_modem_gnss_pvt_data_frame current_pvt;
extern struct nrf_modem_gnss_pvt_data_frame last_pvt;
enum tracker_status
{
	status_nolte = DK_LED1,
	status_searching = DK_LED2,
	status_fixed = DK_LED3
};

/* FUNCTION PROTOTYPES */
void print_fix_data(struct nrf_modem_gnss_pvt_data_frame *pvt_data);
int gnss_init_and_start(void);
void createFauxFix(void);

#endif // GNSS_H
```

## src/sensors.h
```c
#ifndef sensors_H
#define sensors_H

#include <zephyr/device.h>
#include <zephyr/drivers/sensor.h>

// Struct that holds bme280 sensor data
typedef struct
{
	struct device *dev;
	struct sensor_value temperature; // Temperature in degrees Celsius
	struct sensor_value pressure;	 // Pressure in hPa (I think)
	struct sensor_value humidity;	 // Humidity in %RH (relative humidity)
} bme280_data;

// Struct that holds ADXL362 sensor data
typedef struct
{
	struct device *dev;			   // Pointer to the ADXL362 device
	struct sensor_value accel_x;   // Acceleration in the x direction in m/s^2
	struct sensor_value accel_y;   // Acceleration in the y direction in m/s^2
	struct sensor_value accel_z;   // Acceleration in the z direction in m/s^2
	struct sensor_value accel_xyz; // Acceleration in all directions in m/s^2
	struct sensor_value die_temp;  // Internal temperature of the ADXL362 in degrees Celsius
} adxl362_data;

// Struct that holds ADXL362 sensor data
typedef struct
{
	struct device *dev;			   // Pointer to the ADXL362 device
	struct sensor_value accel_x;   // Acceleration in the x direction in m/s^2
	struct sensor_value accel_y;   // Acceleration in the y direction in m/s^2
	struct sensor_value accel_z;   // Acceleration in the z direction in m/s^2
	struct sensor_value accel_xyz; // Acceleration in all directions in m/s^2
} adxl372_data;

// Struct that holds multiple sensors' data
typedef struct
{
	bme280_data bme280;
	adxl362_data adxl362;
	adxl372_data adxl372;
} sensors_s;


int sensors_init(sensors_s *sensors);
int read_sensors(sensors_s *sensors);

#endif // sensors_H
```
