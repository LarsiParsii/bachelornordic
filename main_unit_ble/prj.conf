## prj.conf
```kconfig
# Logger module
CONFIG_LOG=y
# Below setting adjusts the log level:
# 0: off, 1: error, 2: warning, 3: info, 4: debug (all)
CONFIG_LOG_MAX_LEVEL=3


# Button and LED library   
CONFIG_DK_LIBRARY=y

# Bluetooth LE
CONFIG_BT=y
CONFIG_BT_PERIPHERAL=y
CONFIG_BT_DEVICE_NAME="Main Unit"

CONFIG_BT_USER_DATA_LEN_UPDATE=y
CONFIG_BT_BUF_ACL_RX_SIZE=251
CONFIG_BT_BUF_ACL_TX_SIZE=251
CONFIG_BT_CTLR_DATA_LENGTH_MAX=251
CONFIG_BT_L2CAP_TX_MTU=247
CONFIG_BT_L2CAP_TX_BUF_COUNT=10

# LTE and GPS control
#   CONFIG_LTE_LINK_CONTROL=y
#   CONFIG_LTE_NETWORK_MODE_LTE_M_GPS=y
#   CONFIG_DEBUG_THREAD_INFO=y
#   CONFIG_DEBUG_OPTIMIZATIONS=y

# Enable printing floating-point numbers
CONFIG_NEWLIB_LIBC=y
CONFIG_NEWLIB_LIBC_FLOAT_PRINTF=y
CONFIG_FPU=y

# DIS (Device Information Service) info
CONFIG_BT_DIS=y
CONFIG_BT_DIS_SETTINGS=y
CONFIG_BT_DIS_STR_MAX=21
CONFIG_BT_DIS_MODEL="Main Unit I"
CONFIG_BT_DIS_MANUF="E2316 Enterprises"
CONFIG_BT_DIS_SERIAL_NUMBER=y
CONFIG_BT_DIS_SERIAL_NUMBER_STR="MAIN-0001"
CONFIG_BT_DIS_SW_REV=y
CONFIG_BT_DIS_SW_REV_STR="0.1.0"
CONFIG_BT_DIS_FW_REV=n
# CONFIG_BT_DIS_FW_REV_STR="Zephyr Firmware"
CONFIG_BT_DIS_HW_REV=n
# CONFIG_BT_DIS_HW_REV_STR="Zephyr Hardware"
CONFIG_BT_DIS_PNP=n
```

## src/main.c
```c
/*
 * Copyright (c) 2023 Nordic Semiconductor ASA
 *
 * SPDX-License-Identifier: LicenseRef-Nordic-5-Clause
 */

#include <zephyr/kernel.h>
#include <zephyr/logging/log.h>
#include <dk_buttons_and_leds.h>

#include "gss.h"
#include "gps.h"
#include "mob.h"
#include "ble.h"

LOG_MODULE_REGISTER(main_c, LOG_LEVEL_DBG);

#define RUN_LED_BLINK_INTERVAL 1000
#define INDICATE_INTERVAL 500

#define STACKSIZE 1024
#define PRIORITY 7

struct bt_conn_cb connection_callbacks = {
	.connected = on_connected,
	.disconnected = on_disconnected,
};

static gss_cb_s app_callbacks = {
	.gps_cb = getGPSData,
	.mob_cb = getMOBStatus,
};


void send_gps_data_thread(void)
{
	while (1)
	{
		/* Send indication, the function sends notifications only if a client is subscribed */
		gss_send_gps_indicate(getGPSData());
		k_sleep(K_MSEC(INDICATE_INTERVAL));
	}
}

void send_mob_data_thread(void)
{
	while (1)
	{
		/* Send indication, the function sends notifications only if a client is subscribed */
		gss_send_mob_indicate(getMOBStatus());
		k_sleep(K_MSEC(INDICATE_INTERVAL));
	}
}

void main(void)
{
	LOG_ERR("Error log level enabled\n");
	LOG_WRN("Warning log level enabled\n");
	LOG_INF("Info log level enabled\n");
	LOG_DBG("Debug log level enabled\n\n");

	int blink_status = 0;
	int err;

	LOG_INF("Starting main unit application \n");

	err = dk_leds_init();
	if (err)
	{
		LOG_ERR("LEDs init failed (err %d)\n", err);
		return;
	}

	err = gss_init(&app_callbacks);
	if (err)
	{
		LOG_ERR("Failed to init GSS (err:%d)\n", err);
		return;
	}

	ble_init(&connection_callbacks);

	for (;;)
	{
		dk_set_led(RUN_STATUS_LED, (++blink_status) % 2);
		k_sleep(K_MSEC(RUN_LED_BLINK_INTERVAL));
	}
}

K_THREAD_DEFINE(send_gps_data_thread_id, STACKSIZE, send_gps_data_thread, NULL, NULL,
				NULL, PRIORITY, 0, 0);
K_THREAD_DEFINE(send_mob_data_thread_id, STACKSIZE, send_mob_data_thread, NULL, NULL,
				NULL, PRIORITY, 0, 0);
```

## src/ble.c
```c
#include <zephyr/logging/log.h>
#include <zephyr/types.h>
#include <stddef.h>
#include <string.h>
#include <errno.h>

#include <zephyr/bluetooth/gatt.h>
#include <zephyr/bluetooth/conn.h>

#include "ble.h"
#include "gss.h"

LOG_MODULE_REGISTER(conn);

/* ADVERTISING PARAMETERS */
/* Connectable advertising and use identity address */
static struct bt_le_adv_param *adv_param = BT_LE_ADV_PARAM((BT_LE_ADV_OPT_CONNECTABLE | BT_LE_ADV_OPT_USE_IDENTITY),
														   800,	  /*Min Advertising Interval 500ms (800*0.625ms) */
														   2400,  /*Max Advertising Interval 1500ms (2400*0.625ms)*/
														   NULL); /* Set to NULL for undirected advertising*/

static const struct bt_data ad[] = {
	BT_DATA_BYTES(BT_DATA_FLAGS, (BT_LE_AD_GENERAL | BT_LE_AD_NO_BREDR)),
	BT_DATA_BYTES(BT_DATA_UUID16_ALL, BT_UUID_DIS_VAL),
	BT_DATA(BT_DATA_MANUFACTURER_DATA, CONFIG_BT_DIS_SERIAL_NUMBER_STR, sizeof(CONFIG_BT_DIS_SERIAL_NUMBER_STR) - 1),
};

static const struct bt_data sd[] = {
	BT_DATA_BYTES(BT_DATA_UUID128_ALL, BT_UUID_GSS_VAL),
	BT_DATA(BT_DATA_NAME_COMPLETE, CONFIG_BT_DEVICE_NAME, sizeof(CONFIG_BT_DEVICE_NAME) - 1),
};

int ble_init(struct bt_conn_cb *connection_cb)
{
	int err;
	err = bt_enable(NULL);
	if (err)
	{
		LOG_ERR("Bluetooth init failed (err %d)\n", err);
		return err;
	}
	bt_conn_cb_register(connection_cb);

	LOG_INF("Bluetooth initialized\n");
	err = bt_le_adv_start(adv_param, ad, ARRAY_SIZE(ad),
						  sd, ARRAY_SIZE(sd));
	if (err)
	{
		LOG_ERR("Advertising failed to start (err %d)\n", err);
		return err;
	}

	LOG_INF("Advertising successfully started\n");
	return 0;
}

/* BLUETOOTH CONNECTION CALLBACKS */

void on_connected(struct bt_conn *conn, uint8_t err)
{
	if (err)
	{
		LOG_INF("Connection failed (err %u)\n", err);
		return;
	}

	LOG_INF("Connected\n");

	dk_set_led_on(CON_STATUS_LED);
}

void on_disconnected(struct bt_conn *conn, uint8_t reason)
{
	LOG_INF("Disconnected (reason %u)\n", reason);

	dk_set_led_off(CON_STATUS_LED);
}
```

## src/ble.h
```c
#ifndef ble_H
#define ble_H

/* Includes */
#include <zephyr/bluetooth/conn.h>

/* Defines */

/* Function prototypes */
int ble_init(struct bt_conn_cb *bt_connection_cb);

/* Bluetooth connection callbacks */
void on_connected(struct bt_conn *conn, uint8_t err);
void on_disconnected(struct bt_conn *conn, uint8_t reason);

#endif  // ble_H
```

## src/gps.h
```c
#ifndef gps_H_
#define gps_H_

// Includes

// Structs
typedef struct {
	double longitude;
	double latitude;
	float altitude;
	float accuracy;
} gps_data_s;

// Function prototypes
gps_data_s getGPSData(void);

#endif /* gps_H_ */
```

## src/mob.c
```c
#include "mob.h"

// Dummy function that returns a humidity value
bool getMOBStatus(void) {
	return true;
}
```

## src/mob.h
```c
#ifndef hum_H_
#define hum_H_

// Includes
#include <stdbool.h>

// Function prototypes
bool getMOBStatus(void);

#endif /* hum_H_ */
```
