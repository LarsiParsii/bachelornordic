## CMakeLists.txt
```
# SPDX-License-Identifier: Apache-2.0

cmake_minimum_required(VERSION 3.20.0)

find_package(Zephyr REQUIRED HINTS $ENV{ZEPHYR_BASE})
project(NONE)

target_sources(app PRIVATE
    src/main.c
    src/gss.c
	src/ble.c
	src/gps.c
	src/mob.c
)
```

## prj.conf
```kconfig
# Logger module
CONFIG_LOG=y
# Below setting adjusts the log level:
# 0: off, 1: error, 2: warning, 3: info, 4: debug (all)
CONFIG_LOG_MAX_LEVEL=4


# Button and LED library   
CONFIG_DK_LIBRARY=y

# Bluetooth LE
CONFIG_BT=y
CONFIG_BT_PERIPHERAL=y
CONFIG_BT_DEVICE_NAME="Main Unit"

CONFIG_BT_USER_DATA_LEN_UPDATE=y
CONFIG_BT_BUF_ACL_RX_SIZE=251
CONFIG_BT_BUF_ACL_TX_SIZE=251
CONFIG_BT_CTLR_DATA_LENGTH_MAX=251
CONFIG_BT_L2CAP_TX_MTU=247
CONFIG_BT_L2CAP_TX_BUF_COUNT=10

# LTE and GPS control
#   CONFIG_LTE_LINK_CONTROL=y
#   CONFIG_LTE_NETWORK_MODE_LTE_M_GPS=y
#   CONFIG_DEBUG_THREAD_INFO=y
#   CONFIG_DEBUG_OPTIMIZATIONS=y

# Enable printing floating-point numbers
CONFIG_NEWLIB_LIBC=y
CONFIG_NEWLIB_LIBC_FLOAT_PRINTF=y
CONFIG_FPU=y

# DIS (Device Information Service) info
CONFIG_BT_DIS=y
CONFIG_BT_DIS_SETTINGS=y
CONFIG_BT_DIS_STR_MAX=21
CONFIG_BT_DIS_MODEL="Main Unit I"
CONFIG_BT_DIS_MANUF="E2316 Enterprises"
CONFIG_BT_DIS_SERIAL_NUMBER=y
CONFIG_BT_DIS_SERIAL_NUMBER_STR="MAIN-0001"
CONFIG_BT_DIS_SW_REV=y
CONFIG_BT_DIS_SW_REV_STR="0.1.0"
CONFIG_BT_DIS_FW_REV=n
# CONFIG_BT_DIS_FW_REV_STR="Zephyr Firmware"
CONFIG_BT_DIS_HW_REV=n
# CONFIG_BT_DIS_HW_REV_STR="Zephyr Hardware"
CONFIG_BT_DIS_PNP=n
```

## src/main.c
```c
/*
 * Copyright (c) 2023 Nordic Semiconductor ASA
 *
 * SPDX-License-Identifier: LicenseRef-Nordic-5-Clause
 */

#include <zephyr/kernel.h>
#include <zephyr/logging/log.h>
#include <dk_buttons_and_leds.h>

#include "gss.h"
#include "gps.h"
#include "mob.h"
#include "ble.h"

LOG_MODULE_REGISTER(main_c, LOG_LEVEL_DBG);

#define RUN_LED_BLINK_INTERVAL 1000
#define INDICATE_INTERVAL 500

#define STACKSIZE 1024
#define PRIORITY 7

struct bt_conn_cb connection_callbacks = {
	.connected = on_connected,
	.disconnected = on_disconnected,
};

static gss_cb_s app_callbacks = {
	.gps_cb = getGPSData,
	.mob_cb = getMOBStatus,
};


void send_data_thread(void)
{
	while (1)
	{
		/* Send indication, the function sends notifications only if a client is subscribed */
		gss_send_gps_indicate(getGPSData());
		k_sleep(K_MSEC(INDICATE_INTERVAL));
		gss_send_mob_indicate(getMOBStatus());
		k_sleep(K_MSEC(INDICATE_INTERVAL));
	}
}

void main(void)
{
	LOG_ERR("Error log level enabled\n");
	LOG_WRN("Warning log level enabled\n");
	LOG_INF("Info log level enabled\n");
	LOG_DBG("Debug log level enabled\n\n");

	int blink_status = 0;
	int err;

	LOG_INF("Starting MOB unit application \n");

	err = dk_leds_init();
	if (err)
	{
		LOG_ERR("LEDs init failed (err %d)\n", err);
		return;
	}

	err = gss_init(&app_callbacks);
	if (err)
	{
		LOG_ERR("Failed to init GSS (err:%d)\n", err);
		return;
	}

	ble_init(&connection_callbacks);

	for (;;)
	{
		dk_set_led(RUN_STATUS_LED, (++blink_status) % 2);
		k_sleep(K_MSEC(RUN_LED_BLINK_INTERVAL));
	}
}

K_THREAD_DEFINE(send_data_thread_id, STACKSIZE, send_data_thread, NULL, NULL,
				NULL, PRIORITY, 0, 0);
```

## src/ble.c
```c
#include <zephyr/logging/log.h>
#include <zephyr/types.h>
#include <stddef.h>
#include <string.h>
#include <errno.h>

#include <zephyr/bluetooth/gatt.h>
#include <zephyr/bluetooth/conn.h>

#include "ble.h"
#include "gss.h"

LOG_MODULE_REGISTER(conn);

/* ADVERTISING PARAMETERS */
/* Connectable advertising and use identity address */
static struct bt_le_adv_param *adv_param = BT_LE_ADV_PARAM((BT_LE_ADV_OPT_CONNECTABLE | BT_LE_ADV_OPT_USE_IDENTITY),
														   800,	  /*Min Advertising Interval 500ms (800*0.625ms) */
														   2400,  /*Max Advertising Interval 1500ms (2400*0.625ms)*/
														   NULL); /* Set to NULL for undirected advertising*/

static const struct bt_data ad[] = {
	BT_DATA_BYTES(BT_DATA_FLAGS, (BT_LE_AD_GENERAL | BT_LE_AD_NO_BREDR)),
	BT_DATA(BT_DATA_MANUFACTURER_DATA, CONFIG_BT_DIS_MODEL, sizeof(CONFIG_BT_DIS_MODEL) - 1),
	BT_DATA(BT_DATA_MANUFACTURER_DATA, CONFIG_BT_DIS_SERIAL_NUMBER_STR, sizeof(CONFIG_BT_DIS_SERIAL_NUMBER_STR) - 1),
};

static const struct bt_data sd[] = {
	BT_DATA_BYTES(BT_DATA_UUID128_ALL, BT_UUID_GSS_VAL),
	BT_DATA(BT_DATA_NAME_COMPLETE, CONFIG_BT_DEVICE_NAME, sizeof(CONFIG_BT_DEVICE_NAME) - 1),
};

int ble_init(struct bt_conn_cb *connection_cb)
{
	int err;
	err = bt_enable(NULL);
	if (err)
	{
		LOG_ERR("Bluetooth init failed (err %d)\n", err);
		return err;
	}
	bt_conn_cb_register(connection_cb);

	LOG_INF("Bluetooth initialized\n");
	err = bt_le_adv_start(adv_param, ad, ARRAY_SIZE(ad),
						  sd, ARRAY_SIZE(sd));
	if (err)
	{
		LOG_ERR("Advertising failed to start (err %d)\n", err);
		return err;
	}

	LOG_INF("Advertising successfully started\n");
	return 0;
}

/* BLUETOOTH CONNECTION CALLBACKS */

void on_connected(struct bt_conn *conn, uint8_t err)
{
	if (err)
	{
		LOG_INF("Connection failed (err %u)\n", err);
		return;
	}

	LOG_INF("Connected\n");

	dk_set_led_on(CON_STATUS_LED);
}

void on_disconnected(struct bt_conn *conn, uint8_t reason)
{
	LOG_INF("Disconnected (reason %u)\n", reason);

	dk_set_led_off(CON_STATUS_LED);
}
```

## src/gps.c
```c
#include "gps.h"

// Dummy function that returns a gps data struct
gps_data_s getGPSData(void) {
	gps_data_s gps_data = {
		.longitude = 12.3456789,
		.latitude = 0.987654321,
		.altitude = 123.456,
		.accuracy = 0.123
	};
	return gps_data;
}
```

## src/gps.h
```c
#ifndef gps_H_
#define gps_H_

// Includes

// Structs
typedef struct dummy_gps_data {
	double longitude;
	double latitude;
	float altitude;
	float accuracy;
} dummy_gps_data_t;

// Prototypes

#endif /* gps_H_ */
```

## src/gss.c
```c
/**
 * @file gss.c
 * @brief Implementation of the GPS Sensor Service (GSS).
 */

#include <zephyr/types.h>
#include <stddef.h>
#include <string.h>
#include <errno.h>
#include <zephyr/sys/printk.h>
#include <zephyr/sys/byteorder.h>
#include <zephyr/kernel.h>

#include <zephyr/bluetooth/bluetooth.h>
#include <zephyr/bluetooth/hci.h>
#include <zephyr/bluetooth/conn.h>
#include <zephyr/bluetooth/uuid.h>
#include <zephyr/bluetooth/gatt.h>

#include "gss.h"
#include "gps.h"

#include <zephyr/logging/log.h>

LOG_MODULE_REGISTER(gss, LOG_LEVEL_DBG);

static gss_cb_s		gss_cb;
static gps_data_s	gps_data;
static bool			mob_status;

static bool indicate_enabled_gps;
static bool indicate_enabled_mob;
static struct bt_gatt_indicate_params ind_params_gps;	// Indication parameters for GPS data
static struct bt_gatt_indicate_params ind_params_mob;	// Indication parameters for MOB event

/* CALLBACKS */

/**
 * @brief Registers application callbacks for the GSS service.
 *
 * @param callbacks Pointer to the structure containing the callback functions.
 * @return int 0 on success, negative error code otherwise.
 */
int gss_init(gss_cb_s *callbacks)
{
	if (callbacks)
	{
		gss_cb.gps_cb = callbacks->gps_cb;
		gss_cb.mob_cb = callbacks->mob_cb;
	}
	
	return 0;
}

/**
 * @brief Callback invoked when reading MOB event status.
 *
 * @param conn Connection object.
 * @param attr Attribute object.
 * @param buf Buffer to store the attribute value.
 * @param len Length of the buffer.
 * @param offset Offset within the attribute value.
 * @return ssize_t Number of bytes read, or negative error code on failure.
 */
static ssize_t read_mob_event_status(struct bt_conn *conn,
									 const struct bt_gatt_attr *attr,
									 void *buf,
									 uint16_t len,
									 uint16_t offset)
{
	const char *value;
	if (attr->user_data != NULL)
	{
		// LOG_DBG("User data is not NULL");
		value = attr->user_data;
	}
	else
	{
		// LOG_DBG("User data is NULL");
		return 0;
	}
	LOG_DBG("Attribute read, handle: %u, conn: %p", attr->handle,
			(void *)conn);

	if (gss_cb.mob_cb)
	{
		// Call the application callback function to update
		mob_status = gss_cb.mob_cb();
		return bt_gatt_attr_read(conn, attr, buf, len, offset, value,
								 sizeof(*value));
	}
	return 0;
}

static ssize_t read_gps_data(struct bt_conn *conn,
									 const struct bt_gatt_attr *attr,
									 void *buf,
									 uint16_t len,
									 uint16_t offset)
{
	const gps_data_s *value;
	if (attr->user_data != NULL)
	{
		value = attr->user_data;
	}
	else
	{
		return 0;
	}
	LOG_DBG("Attribute read, handle: %u, conn: %p", attr->handle,
			(void *)conn);

	if (gss_cb.gps_cb)
	{
		// Call the application callback function to update
		gps_data = gss_cb.gps_cb();
		return bt_gatt_attr_read(conn, attr, buf, len, offset, value,
								 sizeof(*value));
	}
	return 0;
}

/* INDICATION FUNCTIONS */

static void gss_ccc_gps_changed(const struct bt_gatt_attr *attr,
								uint16_t value)
{
	indicate_enabled_gps = (value == BT_GATT_CCC_INDICATE);
	if (indicate_enabled_gps)
	{
		LOG_INF("GPS indication enabled");
	}
	else
	{
		LOG_INF("GPS indication disabled");
	}
}
static void gss_ccc_mob_changed(const struct bt_gatt_attr *attr,
								uint16_t value)
{
	indicate_enabled_mob = (value == BT_GATT_CCC_INDICATE);
	if (indicate_enabled_mob)
	{
		LOG_INF("MOB event indication enabled");
	}
	else
	{
		LOG_INF("MOB event indication disabled");
	}
}

//This function is called 
static void indicate_started_gps_cb(struct bt_conn *conn,
			struct bt_gatt_indicate_params *params, uint8_t err)
{
	LOG_DBG("GPS indication started %s\n", err != 0U ? "fail" : "success");
}
static void indicate_started_mob_cb(struct bt_conn *conn,
			struct bt_gatt_indicate_params *params, uint8_t err)
{
	LOG_DBG("MOB indication started %s\n", err != 0U ? "fail" : "success");
}
// 
static void indicate_ended_gps_cb()
{
	LOG_DBG("GPS indication finished.\n");
}
static void indicate_ended_mob_cb()
{
	LOG_DBG("MOB indication finished.\n");
}

/* INDICATIONS */
int gss_send_gps_indicate(gps_data_s gps_data)
{
	if (!indicate_enabled_gps) {
		return -EACCES;
	}
	ind_params_gps.uuid = BT_UUID_GSS_GPS;
	ind_params_gps.func = indicate_started_gps_cb; //A remote device has ACKed at its host layer (ATT ACK)
	ind_params_gps.destroy = indicate_ended_gps_cb;
	ind_params_gps.data = &gps_data;
	ind_params_gps.len = sizeof(gps_data);
	LOG_DBG("Sending GPS indication");
	return bt_gatt_indicate(NULL, &ind_params_gps);
}

int gss_send_mob_indicate(bool mob_status)
{
	if (!indicate_enabled_mob)
	{
		return -EACCES;
	}
	ind_params_mob.uuid = BT_UUID_GSS_MOB;
	ind_params_mob.func = indicate_started_mob_cb; // A remote device has ACKed at its host layer (ATT ACK)
	ind_params_mob.destroy = indicate_ended_mob_cb;
	ind_params_mob.data = &mob_status;
	ind_params_mob.len = sizeof(mob_status);
	return bt_gatt_indicate(NULL, &ind_params_mob);
}

/* GPS Sensor Service Declaration */
/* Creates and adds the GSS service to the Bluetooth LE stack */
BT_GATT_SERVICE_DEFINE(gss_svc,
						BT_GATT_PRIMARY_SERVICE(BT_UUID_GSS),
						/* GPS Coordinate Characteristic */
						BT_GATT_CHARACTERISTIC(BT_UUID_GSS_GPS,
											  BT_GATT_CHRC_READ | BT_GATT_CHRC_INDICATE,
											  BT_GATT_PERM_READ,
											  read_gps_data,
											  NULL,
											  &gps_data),
						BT_GATT_CCC(gss_ccc_gps_changed,
								BT_GATT_PERM_READ | BT_GATT_PERM_WRITE),
						/* MOB Event Characteristic */
						BT_GATT_CHARACTERISTIC(BT_UUID_GSS_MOB,
											  BT_GATT_CHRC_READ | BT_GATT_CHRC_INDICATE,
											  BT_GATT_PERM_READ,
											  read_mob_event_status,
											  NULL,
											  &mob_status),
						BT_GATT_CCC(gss_ccc_mob_changed,
								BT_GATT_PERM_READ | BT_GATT_PERM_WRITE),

);
```

## src/gss.h
```c
#ifndef GSS_H_
#define GSS_H_

#ifdef __cplusplus
extern "C"
{
#endif

#include <zephyr/types.h>
#include <stddef.h>
#include <string.h>
#include <errno.h>
#include <zephyr/sys/printk.h>
#include <zephyr/sys/byteorder.h>
#include <zephyr/kernel.h>

#include <dk_buttons_and_leds.h>

#include <zephyr/bluetooth/bluetooth.h>
#include <zephyr/bluetooth/hci.h>
#include <zephyr/bluetooth/conn.h>
#include <zephyr/bluetooth/uuid.h>
#include <zephyr/bluetooth/gatt.h>

#include "gps.h"

#define RUN_STATUS_LED          DK_LED1
#define CON_STATUS_LED          DK_LED2
/* LED to control */
#define USER_LED DK_LED3
/* Button to monitor */
#define USER_BUTTON DK_BTN1_MSK

/* CUSTOM SERVICE UUIDs */

/** @brief GSS Service UUID. */
#define BT_UUID_GSS_VAL \
	BT_UUID_128_ENCODE(0x6dea7370, 0x0bdf, 0x43db, 0x8ea8, 0x1c3a6a7e5909)

/** @brief GPS Characteristic UUID. */
#define BT_UUID_GSS_GPS_VAL \
	BT_UUID_128_ENCODE(0x6dea7371, 0x0bdf, 0x43db, 0x8ea8, 0x1c3a6a7e5909)

/** @brief Humidity Sensor Characteristic UUID. */
#define BT_UUID_GSS_MOB_VAL \
	BT_UUID_128_ENCODE(0x6dea7372, 0x0bdf, 0x43db, 0x8ea8, 0x1c3a6a7e5909)

#define BT_UUID_GSS           BT_UUID_DECLARE_128(BT_UUID_GSS_VAL)
#define BT_UUID_GSS_GPS       BT_UUID_DECLARE_128(BT_UUID_GSS_GPS_VAL)
#define BT_UUID_GSS_MOB       BT_UUID_DECLARE_128(BT_UUID_GSS_MOB_VAL)


/* CALLBACK STRUCTURE */

/** @brief Callback type for reading the GPS data */
typedef gps_data_s (*gps_cb_t)(void);

/** @brief Callback type for humidity sensor reading */
typedef bool (*mob_cb_t)(void);


/** @brief Callback struct used by the GSS Service. */
typedef struct {
	/** GPS reading callback. */
	gps_cb_t gps_cb;
	/** Humidity change callback. */
	mob_cb_t mob_cb;
} gss_cb_s;


/* FUNCTION PROTOTYPES */

/* Callbacks */
/** @brief Initialize the GSS Service.
 * This function registers application callback functions with the GSS Service
 * @param[in] callbacks Struct containing pointers to callback functions
 *			used by the service. This pointer can be NULL
 *			if no callback functions are defined.
 * @retval 0 If the operation was successful.
 *           Otherwise, a (negative) error code is returned.
 */
int gss_init(gss_cb_s *callbacks);

int gss_send_gps_indicate(gps_data_s gps_data);

int gss_send_mob_indicate(bool mob_status);	

#ifdef __cplusplus
}
#endif

#endif /* GSS_H_ */
```

## src/hum.c
```c
#include "hum.h"

// Dummy function that returns a humidity value
int getHumidity(void) {
	return 69;
}
```

## src/hum.h
```c
#ifndef hum_H_
#define hum_H_

// Includes

// Structs

// Prototypes
int getHumidity(void);

#endif /* hum_H_ */
```
